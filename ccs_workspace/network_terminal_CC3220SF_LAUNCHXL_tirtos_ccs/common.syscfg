/**
 * @cliArgs --board "/ti/boards/CC3220SF_LAUNCHXL" --product "simplelink_cc32xx_sdk@4.40.00.07" --product "sail@1.50.00.00"
 * @versions {"data":"2021010520","timestamp":"2021010520","tool":"1.7.0+1746","templates":null}
 */

/**
 * Import the modules used in this configuration.
 */
const DriverLib      = scripting.addModule("/ti/devices/DriverLib");
const Display        = scripting.addModule("/ti/display/Display");
const Display1       = Display.addInstance();
const ADC            = scripting.addModule("/ti/drivers/ADC", {}, false);
const ADC1           = ADC.addInstance();
const ADC2           = ADC.addInstance();
const ADC3           = ADC.addInstance();
const Board          = scripting.addModule("/ti/drivers/Board");
const Crypto         = scripting.addModule("/ti/drivers/Crypto");
const Crypto1        = Crypto.addInstance();
const DMA            = scripting.addModule("/ti/drivers/DMA");
const GPIO           = scripting.addModule("/ti/drivers/GPIO");
const GPIO1          = GPIO.addInstance();
const GPIO2          = GPIO.addInstance();
const GPIO3          = GPIO.addInstance();
const GPIO4          = GPIO.addInstance();
const GPIO5          = GPIO.addInstance();
const I2C            = scripting.addModule("/ti/drivers/I2C", {}, false);
const I2C1           = I2C.addInstance();
const Power          = scripting.addModule("/ti/drivers/Power");
const RTOS           = scripting.addModule("/ti/drivers/RTOS");
const SPI            = scripting.addModule("/ti/drivers/SPI");
const SPI1           = SPI.addInstance();
const Timer          = scripting.addModule("/ti/drivers/Timer");
const Timer1         = Timer.addInstance();
const Timer2         = Timer.addInstance();
const Timer3         = Timer.addInstance();
const Watchdog       = scripting.addModule("/ti/drivers/Watchdog");
const Watchdog1      = Watchdog.addInstance();
const SimpleLinkWifi = scripting.addModule("/ti/drivers/net/wifi/SimpleLinkWifi");
const atcmd          = scripting.addModule("/ti/drivers/net/wifi/atcmd", {}, false);
const atcmd1         = atcmd.addInstance();
const net_utils      = scripting.addModule("/ti/drivers/net/wifi/net_utils", {}, false);
const net_utils1     = net_utils.addInstance();
const HTTPClient     = scripting.addModule("/ti/net/HTTPClient", {}, false);
const HTTPClient1    = HTTPClient.addInstance();
const MQTT           = scripting.addModule("/ti/net/MQTT", {}, false);
const MQTT1          = MQTT.addInstance();
const SNTP           = scripting.addModule("/ti/net/SNTP");
const SlNet          = scripting.addModule("/ti/net/SlNet");
const SlNet1         = SlNet.addInstance();
const JSON           = scripting.addModule("/ti/utils/JSON");

/**
 * Write custom configuration values to the imported modules.
 */
Display1.$name                   = "CONFIG_Display_0";
Display1.$hardware               = system.deviceData.board.components.XDS110UART;
Display1.uart.$name              = "CONFIG_UART_0";
Display1.uart.uart.$assign       = "UART0";
Display1.uart.uart.txPin.$assign = "55";
Display1.uart.uart.rxPin.$assign = "57";

ADC1.$name     = "CONFIG_ADC_0";
ADC1.$hardware = system.deviceData.board.components.OPA4342.subComponents.AIN2;

ADC2.$name     = "CONFIG_ADC_1";
ADC2.$hardware = system.deviceData.board.components.OPA4342.subComponents.AIN3;

ADC3.$name     = "CONFIG_ADC_2";
ADC3.$hardware = system.deviceData.board.components.OPA4342.subComponents.AIN4;

Crypto1.$name = "CONFIG_Crypto_0";

GPIO1.$hardware       = system.deviceData.board.components.SW3;
GPIO1.$name           = "CONFIG_GPIO_BUTTON_1";
GPIO1.gpioPin.$assign = "boosterpack.11";

GPIO2.$hardware      = system.deviceData.board.components.LED_RED;
GPIO2.outputStrength = "High";
GPIO2.$name          = "CONFIG_GPIO_LED_0";

GPIO3.$name           = "CONFIG_GPIO_0";
GPIO3.mode            = "Dynamic";
GPIO3.gpioPin.$assign = "boosterpack.19";

GPIO4.$name           = "CONFIG_GPIO_2";
GPIO4.mode            = "Dynamic";
GPIO4.gpioPin.$assign = "boosterpack.4";

GPIO5.$hardware       = system.deviceData.board.components.BMA222E.subComponents.INTERRUPT;
GPIO5.$name           = "CONFIG_GPIO_BMA222E_INT";
GPIO5.gpioPin.$assign = "boosterpack.3";

I2C1.$name              = "CONFIG_I2C_BMA222E";
I2C1.$hardware          = system.deviceData.board.components.LP_I2C;
I2C1.i2c.$assign        = "I2C0";
I2C1.i2c.sdaPin.$assign = "boosterpack.10";
I2C1.i2c.sclPin.$assign = "boosterpack.9";

Power.parkPins.$name = "ti_drivers_power_PowerCC32XXPins0";

SPI1.$name                    = "CONFIG_SPI_0";
SPI1.mode                     = "Four Pin SS Active Low";
SPI1.defaultTxBufferValue     = "0";
SPI1.spi.$assign              = "SPI0";
SPI1.spi.sclkPin.$assign      = "boosterpack.7";
SPI1.spi.misoPin.$assign      = "boosterpack.14";
SPI1.spi.mosiPin.$assign      = "boosterpack.15";
SPI1.spi.dmaRxChannel.$assign = "UDMA_CH6";
SPI1.spi.dmaTxChannel.$assign = "UDMA_CH7";
SPI1.spi.ssPin.$assign        = "boosterpack.18";

Timer1.$name         = "CONFIG_TIMER_0";
Timer1.timerType     = "32 Bits";
Timer1.timer.$assign = "Timer0";

Timer2.$name         = "CONFIG_TIMER_1";
Timer2.timer.$assign = "Timer1";

Timer3.$name         = "CONFIG_TIMER_2";
Timer3.timer.$assign = "Timer1";

Watchdog1.$name            = "CONFIG_WATCHDOG_0";
Watchdog1.watchdog.$assign = "WATCHDOG0";

SimpleLinkWifi.deleteAllProfile = true;

atcmd1.$name = "CONFIG_ATCMD_0";

net_utils1.$name = "CONFIG_NET_UTILS_0";

HTTPClient1.$name = "CONFIG_HTTPCLIENT_0";

MQTT1.$name = "CONFIG_MQTT_0";

SlNet1.$name  = "CONFIG_SLNET";
SlNet1.ifName = "CC32xx";

/**
 * Pinmux solution for unlocked pins/peripherals. This ensures that minor changes to the automatic solver in a future
 * version of the tool will not impact the pinmux you originally saw.  These lines can be completely deleted in order to
 * re-solve from scratch.
 */
ADC1.adc.$suggestSolution        = "ADC0";
ADC1.adc.adcPin.$suggestSolution = "boosterpack.2";
ADC2.adc.$suggestSolution        = "ADC0";
ADC2.adc.adcPin.$suggestSolution = "boosterpack.26";
ADC3.adc.$suggestSolution        = "ADC0";
ADC3.adc.adcPin.$suggestSolution = "boosterpack.24";
GPIO2.gpioPin.$suggestSolution   = "boosterpack.29";
